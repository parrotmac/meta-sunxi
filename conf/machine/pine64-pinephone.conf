## conf/machine/pine64-pinephone.conf
```bitbake
#@TYPE: Machine
#@NAME: pine64-pinephone
#@DESCRIPTION: Machine configuration for the pine64-pinephone, based on Allwinner A64 CPU


require conf/machine/include/sun50i.inc

KERNEL_DEVICETREE = "allwinner/sun50i-a64-pinephone-1.1.dtb"
UBOOT_MACHINE = "pine64_pinephone_defconfig"
```
